## meta-enclustra-mpfs/conf/layer.conf
```bitbake
# We have a conf and classes directory, add to BBPATH
BBPATH .= ":${LAYERDIR}"

# We have recipes-* directories, add to BBFILES
BBFILES += "${LAYERDIR}/recipes-*/*/*.bb \
            ${LAYERDIR}/recipes-*/*/*.bbappend"

BBFILE_COLLECTIONS += "meta-enclustra-mpfs"
BBFILE_PATTERN_meta-enclustra-mpfs = "^${LAYERDIR}/"
BBFILE_PRIORITY_meta-enclustra-mpfs = "2"

LAYERDEPENDS_meta-enclustra-mpfs = "core"
LAYERDEPENDS_meta-enclustra-mpfs += "riscv-layer"
LAYERDEPENDS_meta-enclustra-mpfs += "meta-polarfire-soc-yocto-bsp"

LAYERSERIES_COMPAT_meta-enclustra-mpfs = "honister"
```

## meta-enclustra-mpfs/conf/machine/me-mp1-250-si-d3en-e1.conf
```bitbake
#@TYPE: Machine
#@NAME: me-mp1-250-si-d3en-e1
#@SOC: Polarfire SoC
#@DESCRIPTION: Machine configuration for the Enclustra MP1 module

require conf/machine/include/riscv/tune-riscv.inc

MACHINE_FEATURES = "keyboard ext2 serial usbgadget usbhost"
MACHINE_TYPE = "smp"

KERNEL_CLASSES = "kernel-fitimage"
KERNEL_IMAGETYPE = "fitImage"

KERNEL_DEVICETREE ?= "microchip/enclustra_mercury_mp1.dtb"

PREFERRED_PROVIDER_virtual/kernel ?= "mpfs-linux"

PREFERRED_VERSION_openocd-native = "riscv"
PREFERRED_VERSION_openocd = "riscv"

EXTRA_IMAGEDEPENDS += " hss"

UBOOT_MACHINE="enclustra_mercury_mp1_defconfig"
PREFERRED_PROVIDER_virtual/bootloader = "u-boot"
UBOOT_DEVICE_TREE ?= "enclustra_mercury_mp1.dtb"
UBOOT_ENTRYPOINT = "0x80200000"
UBOOT_DTB_LOADADDRESS = "0x82200000"

UBOOT_ENV = "boot"
UBOOT_ENV_SUFFIX = "scr"

HSS_PAYLOAD = "uboot"

SERIAL_CONSOLES = "115200;ttySIF0"

MACHINE_ESSENTIAL_EXTRA_RDEPENDS += " kernel-modules"

IMAGE_FSTYPES += "wic wic.gz ext4"

ENCLUSTRA_BASEBOARD ?= ""

## Do not update fstab file when using wic images
WIC_CREATE_EXTRA_ARGS ?= "--no-fstab-update"

## wic default support
WKS_FILE_DEPENDS ?= " \
    hss \
    u-boot \
    e2fsprogs-native \
    bmap-tools-native \
"

IMAGE_BOOT_FILES ?= " \
    fitImage \
    boot.scr \
"

WKS_FILE ?= "mpfs-icicle-kit.wks"
```

## meta-enclustra-mpfs/recipes-bsp/u-boot/files/enclustra_mercury_mp1_defconfig
```kconfig
CONFIG_RISCV=y
CONFIG_SYS_MALLOC_LEN=0x800000
CONFIG_SYS_MALLOC_F_LEN=0x2000
CONFIG_ENV_SIZE=0x2000
CONFIG_DEFAULT_DEVICE_TREE="enclustra_mercury_mp1"
CONFIG_TARGET_ENCLUSTRA_MERCURY_MP1=y
CONFIG_ARCH_RV64I=y
CONFIG_RISCV_SMODE=y
CONFIG_DISTRO_DEFAULTS=y
CONFIG_SYS_LOAD_ADDR=0x80200000
CONFIG_FIT=y
CONFIG_DISPLAY_CPUINFO=y
CONFIG_DISPLAY_BOARDINFO=y
CONFIG_SYS_PROMPT="Mercury-MP1 # "
CONFIG_SYS_RELOC_GD_ENV_ADDR=y
CONFIG_BOOTP_SEND_HOSTNAME=y
CONFIG_DM_MTD=y
CONFIG_MISC=y
CONFIG_ATSHA204A=y
CONFIG_ENCLUSTRA_EEPROM_MAC=y
CONFIG_SPI=y
CONFIG_DM_SPI=y
CONFIG_MICROCHIP_QSPI=y
CONFIG_MTD_SPI_NAND=y
CONFIG_CMD_MTD=y
CONFIG_MTD_PARTITIONS=y
CONFIG_CMD_MTDPARTS=y
CONFIG_SPI_FLASH_SPANSION=y
CONFIG_SF_DEFAULT_SPEED=50000000
CONFIG_ENV_IS_IN_FAT=y
CONFIG_ENV_FAT_INTERFACE="mmc"
CONFIG_ENV_FAT_DEVICE_AND_PART="0:1"
CONFIG_ENV_FAT_FILE="uboot.env"
```

## meta-enclustra-mpfs/recipes-kernel/linux/files/me-mp1-250-ees-d3e/defconfig
```kconfig
CONFIG_SYSVIPC=y
CONFIG_POSIX_MQUEUE=y
CONFIG_NO_HZ_IDLE=y
CONFIG_HIGH_RES_TIMERS=y
CONFIG_IKCONFIG=y
CONFIG_IKCONFIG_PROC=y
CONFIG_CGROUPS=y
CONFIG_CGROUP_SCHED=y
CONFIG_CFS_BANDWIDTH=y
CONFIG_CGROUP_BPF=y
CONFIG_NAMESPACES=y
CONFIG_USER_NS=y
CONFIG_BLK_DEV_INITRD=y
CONFIG_EXPERT=y
CONFIG_KALLSYMS_ALL=y
CONFIG_BPF_SYSCALL=y
CONFIG_SOC_MICROCHIP_POLARFIRE=y
CONFIG_SMP=y
CONFIG_CMDLINE="earlyprintk root=/dev/mmcblk0p3 rootwait console=ttyS0,115200n8 uio_pdrv_genirq.of_id=generic-uio"
CONFIG_JUMP_LABEL=y
CONFIG_MODULES=y
CONFIG_MODULE_UNLOAD=y
CONFIG_BLK_DEV_ZONED=y
CONFIG_PARTITION_ADVANCED=y
CONFIG_NET=y
CONFIG_PACKET=y
CONFIG_UNIX=y
CONFIG_INET=y
CONFIG_NETLINK_DIAG=y
CONFIG_PCI=y
CONFIG_PCI_DEBUG=y
CONFIG_PCI_HOST_GENERIC=y
CONFIG_PCIE_MICROCHIP_HOST=y
CONFIG_DEVTMPFS=y
CONFIG_DEVTMPFS_MOUNT=y
CONFIG_MTD=y
CONFIG_MTD_BLOCK=y
CONFIG_MTD_SPI_NOR=y
CONFIG_BLK_DEV_LOOP=y
CONFIG_BLK_DEV_NBD=y
CONFIG_BLK_DEV_NVME=y
CONFIG_BLK_DEV_SD=y
CONFIG_BLK_DEV_SR=y
CONFIG_ATA=y
CONFIG_NETDEVICES=y
CONFIG_MACB=y
CONFIG_R8169=y
CONFIG_INPUT_MOUSEDEV=y
CONFIG_INPUT_EVDEV=y
CONFIG_SERIAL_8250=y
CONFIG_SERIAL_8250_CONSOLE=y
CONFIG_SERIAL_OF_PLATFORM=y
CONFIG_SERIAL_EARLYCON_RISCV_SBI=y
CONFIG_HW_RANDOM=y
CONFIG_HW_RANDOM_POLARFIRE_SOC=y
CONFIG_TCG_TPM=y
CONFIG_TCG_TIS=y
CONFIG_TCG_TIS_SPI=y
CONFIG_I2C_CHARDEV=y
CONFIG_I2C_MICROCHIP=y
CONFIG_SPI=y
CONFIG_SPI_SIFIVE=y
CONFIG_SPI_MICROSEMI=y
CONFIG_SPI_MICROSEMI_QSPI=y
CONFIG_GPIOLIB=y
CONFIG_GPIO_SYSFS=y
CONFIG_GPIO_MICROSEMI=y
CONFIG_GPIO_PCA953X=y
CONFIG_POWER_RESET=y
CONFIG_SENSORS_LM80=y
CONFIG_PMBUS=y
CONFIG_MEDIA_SUPPORT=y
CONFIG_MEDIA_USB_SUPPORT=y
CONFIG_USB_VIDEO_CLASS=y
CONFIG_V4L_PLATFORM_DRIVERS=y
CONFIG_DRM=y
CONFIG_DRM_RADEON=y
CONFIG_DRM_NOUVEAU=y
CONFIG_FRAMEBUFFER_CONSOLE=y
CONFIG_USB=y
CONFIG_USB_ANNOUNCE_NEW_DEVICES=y
# CONFIG_USB_DEFAULT_PERSIST is not set
CONFIG_USB_XHCI_HCD=y
CONFIG_USB_XHCI_PLATFORM=y
CONFIG_USB_EHCI_HCD=y
CONFIG_USB_EHCI_HCD_PLATFORM=y
CONFIG_USB_OHCI_HCD=y
CONFIG_USB_OHCI_HCD_PLATFORM=y
CONFIG_USB_ACM=y
CONFIG_USB_STORAGE=y
CONFIG_USB_UAS=y
CONFIG_USB_MUSB_HDRC=y
CONFIG_USB_MUSB_MPFS_MICROCHIP=y
CONFIG_USB_INVENTRA_DMA=y
CONFIG_USB_SERIAL=y
CONFIG_NOP_USB_XCEIV=y
CONFIG_USB_GADGET=y
CONFIG_USB_MASS_STORAGE=m
CONFIG_MMC=y
CONFIG_MMC_SDHCI=y
CONFIG_MMC_SDHCI_PLTFM=y
CONFIG_MMC_SDHCI_CADENCE=y
CONFIG_MMC_SPI=y
CONFIG_NEW_LEDS=y
CONFIG_LEDS_CLASS=y
CONFIG_LEDS_GPIO=y
CONFIG_LEDS_BLINK=y
CONFIG_RTC_CLASS=y
CONFIG_RTC_DRV_ISL12022=y
CONFIG_DMADEVICES=y
CONFIG_SF_PDMA=y
CONFIG_UIO=y
CONFIG_UIO_PDRV_GENIRQ=y
CONFIG_UIO_DMEM_GENIRQ=y
CONFIG_UIO_MICROCHIP_CAN=y
CONFIG_UIO_MICROCHIP_PDMA=y
CONFIG_UIO_MICROSEMI_DMA=y
CONFIG_STAGING=y
CONFIG_ATSHA204_I2C=y
CONFIG_MAILBOX=y
CONFIG_POLARFIRE_SOC_MAILBOX=y
CONFIG_POLARFIRE_SOC_SYS_CTRL=y
CONFIG_POLARFIRE_SOC_GENERIC_SERVICE=y
CONFIG_IIO=y
CONFIG_IIO_BUFFER=y
CONFIG_IIO_TRIGGERED_BUFFER=y
CONFIG_IIO_SW_DEVICE=y
CONFIG_IIO_SW_TRIGGER=y
CONFIG_PWM=y
CONFIG_PWM_MICROCHIP_CORE=y
CONFIG_EXT4_FS=y
CONFIG_EXT4_FS_POSIX_ACL=y
CONFIG_FANOTIFY=y
CONFIG_MSDOS_FS=y
CONFIG_VFAT_FS=y
CONFIG_FAT_DEFAULT_IOCHARSET="ascii"
CONFIG_EXFAT_FS=y
CONFIG_TMPFS=y
CONFIG_TMPFS_POSIX_ACL=y
CONFIG_NFS_FS=y
CONFIG_NFS_V4=y
CONFIG_NFS_V4_1=y
CONFIG_NFS_V4_2=y
CONFIG_NLS_CODEPAGE_437=y
CONFIG_NLS_CODEPAGE_850=y
CONFIG_NLS_ASCII=y
CONFIG_NLS_ISO8859_1=y
CONFIG_NLS_UTF8=y
CONFIG_PRINTK_TIME=y
CONFIG_SCHED_STACK_END_CHECK=y
CONFIG_SOFTLOCKUP_DETECTOR=y
CONFIG_WQ_WATCHDOG=y
CONFIG_SCHEDSTATS=y
CONFIG_DEBUG_SPINLOCK=y
CONFIG_STACKTRACE=y
CONFIG_COMMON_CLK_SI5338=y
```
