// SPDX-License-Identifier: (GPL-2.0+ OR MIT)
/*
 * Copyright (C) 2022 Enclustra GmbH
 * <info@enclustra.com>
 */

/dts-v1/;

#include "enclustra_mercury_mp1_common.dtsi"

/ {
	model = "enclustra,me-mp1-460-1si-d4e";

	aliases {
		ethernet0 = &mac1;
	};

	/* 4 Gbyte DDR4 memory */
	mss_memory: memory@80000000 {
		device_type = "memory";
		reg = <0x0 0x80000000 0x0 0x40000000>, <0x10 0x0 0x0 0xC0000000>;
		status = "okay";
	};
};
